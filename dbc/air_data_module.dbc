VERSION "1.0"

NS_ :

BS_:

BU_: ADM FC

BO_ 2030 ADM_PressureFiltered: 5 ADM
 SG_ Pressure : 0|32@1- (1,0) [25000|125000] "Pa" FC
 SG_ Seq : 32|8@1+ (1,0) [0|255] "" FC

BO_ 2031 ADM_PressureUnfiltered: 5 ADM
 SG_ Pressure : 0|32@1- (1,0) [25000|125000] "Pa" FC
 SG_ Seq : 32|8@1+ (1,0) [0|255] "" FC

CM_ "Air data module raw 11-bit CAN output (node parameter RAWCAN_ENABLE = 1). Layout: lib/RawCanFrame/src/RawCanFrame.h. The IDs here are the firmware defaults (RAWCAN_ID = 0x7EE, RAWCAN_RAW_ID = 0x7EF); edit the BO_ lines if the module uses other IDs.";
CM_ BU_ ADM "Air data module (Beyond Robotix Micro Node with AUAV sensor), Flowcopter firmware.";
CM_ BU_ FC "Flight controller or any other receiver.";
CM_ BO_ 2030 "Filtered static pressure: the value published as DroneCAN StaticPressure, sent with it at BARO_PUB_HZ (default 50 Hz). Filtered unless BARO_LP_ENABLE = 0. Not sent while the reading is unhealthy.";
CM_ BO_ 2031 "Unfiltered static pressure: every sensor sample before the low-pass filter, at BARO_SAMPLE_HZ (default 180 Hz). Not sent while the reading is unhealthy.";
CM_ SG_ 2030 Pressure "Static pressure, IEEE 754 float32, little-endian.";
CM_ SG_ 2030 Seq "Sequence counter, +1 per published value, wraps at 255. Advances for frames that could not be sent, so gaps are visible. Separate from the unfiltered frame's counter.";
CM_ SG_ 2031 Pressure "Static pressure, IEEE 754 float32, little-endian.";
CM_ SG_ 2031 Seq "Sequence counter, +1 per sample, wraps at 255. Advances for frames that could not be sent, so gaps are visible. Separate from the filtered frame's counter.";

BA_DEF_ "BusType" STRING ;
BA_DEF_ BO_ "GenMsgCycleTime" INT 0 65535;
BA_DEF_ BO_ "VFrameFormat" ENUM "StandardCAN","ExtendedCAN";
BA_DEF_DEF_ "BusType" "CAN";
BA_DEF_DEF_ "GenMsgCycleTime" 0;
BA_DEF_DEF_ "VFrameFormat" "StandardCAN";
BA_ "GenMsgCycleTime" BO_ 2030 20;
BA_ "GenMsgCycleTime" BO_ 2031 6;

SIG_VALTYPE_ 2030 Pressure : 1;
SIG_VALTYPE_ 2031 Pressure : 1;
